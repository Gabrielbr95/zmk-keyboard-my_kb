#include "my_kb.dtsi"

/ {
    &kscan0 {
        
        row-gpios = <
            &gpio0 13 (GPIO_ACTIVE_HIGH | GPIO_PULL_DOWN)
            &gpio0 4 (GPIO_ACTIVE_HIGH | GPIO_PULL_DOWN)
            &gpio0 5 (GPIO_ACTIVE_HIGH | GPIO_PULL_DOWN)
            &gpio0 30 (GPIO_ACTIVE_HIGH | GPIO_PULL_DOWN)
            &gpio0 29 (GPIO_ACTIVE_HIGH | GPIO_PULL_DOWN)
            &gpio0 31 (GPIO_ACTIVE_HIGH | GPIO_PULL_DOWN)
        >;

        col-gpios = <
            &gpio0 2 GPIO_ACTIVE_HIGH
            &gpio0 28 GPIO_ACTIVE_HIGH
            &gpio0 3 GPIO_ACTIVE_HIGH
            &gpio1 8 GPIO_ACTIVE_HIGH
            &gpio1 1 GPIO_ACTIVE_HIGH
            &gpio1 2 GPIO_ACTIVE_HIGH
            &gpio0 27 GPIO_ACTIVE_HIGH
            &gpio0 21 GPIO_ACTIVE_HIGH
            &gpio0 23 GPIO_ACTIVE_HIGH
            &gpio1 14 GPIO_ACTIVE_HIGH
            &gpio1 13 GPIO_ACTIVE_HIGH
            &gpio1 15 GPIO_ACTIVE_HIGH
            &gpio1 12 GPIO_ACTIVE_HIGH
            &gpio1 11 GPIO_ACTIVE_HIGH
            &gpio1 10 GPIO_ACTIVE_HIGH
            &gpio1 3 GPIO_ACTIVE_HIGH
        >;
    };
};
