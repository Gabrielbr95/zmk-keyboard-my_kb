## boards/shields/my_kb/Kconfig.defconfig
```kconfig
if SHIELD_MY_KB_MAIN || SHIELD_MY_KB_NPAD || SHIELD_MY_KB_DONGLE
    config ZMK_SPLIT
        default y

    config ZMK_BLE
        default y
   
endif

if SHIELD_MY_KB_DONGLE

# Max 16 characters in keyboard name
config ZMK_KEYBOARD_NAME
    default "My_Keyboard"

config ZMK_SPLIT_ROLE_CENTRAL
    default y

config ZMK_SPLIT_BLE_CENTRAL_PERIPHERALS
    default 2

config I2C
    default y

config SSD1306
    default y

choice ZMK_DISPLAY_WORK_QUEUE
    default ZMK_DISPLAY_WORK_QUEUE_DEDICATED
endchoice

endif
```

## boards/shields/my_kb/Kconfig.shield
```kconfig
config SHIELD_MY_KB_MAIN
    def_bool $(shields_list_contains,my_kb_main)

config SHIELD_MY_KB_NPAD
    def_bool $(shields_list_contains,my_kb_npad)

config SHIELD_MY_KEYBOARD_DONGLE
    def_bool $(shields_list_contains,my_kb_dongle)
```
